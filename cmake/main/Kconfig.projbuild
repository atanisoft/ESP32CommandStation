## main/Kconfig.projbuild
```kconfig
menu "LCC Configuration"
    config LCC_NODE_ID
        hex "Node ID"
        default 0x05020103F000
        help 
            This is the LCC node identifier for the ESP32 Command Station.
            It is recommended, but not required, to request your own ID
            range via:
            https://registry.openlcb.org/requestuniqueidrange
            The default node ID is part of a reserved range of ID values.

    config LCC_CAN_ENABLED
        bool "CAN interface"
        default n
        help
            Enabling this option will require an externally connected
            SN6565HVD23x or MCP2551 IC.

    config LCC_CAN_RX_PIN
        int "CAN RX Pin"
        range 0 39
        depends on LCC_CAN_ENABLED
        help
            This is the ESP32 pin connected to the SN6565HVD23x/MCP2551 R (RX) pin.

    config LCC_CAN_TX_PIN
        int "CAN TX Pin"
        range 0 33
        depends on LCC_CAN_ENABLED
        help
            This is the ESP32 pin connected to the SN6565HVD23x/MCP2551 D (TX) pin.

    config LCC_PRINT_ALL_PACKETS
        bool "Print all packets"
        default n
        depends on !LCC_TCP_STACK
        help
            Enabling this option will cause all LCC packets to be printed to
            the serial console.

    config LCC_GC_NEWLINES
        bool "Add newline to GridConnect packets"
        default y if LCC_PRINT_ALL_PACKETS
        default n
        depends on !LCC_TCP_STACK
        help
            Enabling this option will generate a newline character after
            every GridConnect packet that is sent out. This is generally
            only needed for debug purposes.
        
    config LCC_FACTORY_RESET
        bool "Perform LCC Factory reset on startup"
        default n
        help
            Enabling this option will force the removal of the cached CDI
            and node configuration files on every startup of the node. This
            is generally not required or recommended.

    config LCC_MEMORY_SPACES
        int "MemoryConfig space limit"
        default 10
        help
            Maximum number of memory spaces that can be registered for the
            MemoryConfig datagram handler.

    config LCC_EXECUTOR_SELECT_PRESCALER
        int "StateFlows to execute between select() calls"
        range 5 300
        default 60
        help
            Executors will run this many Executables (if there is anything
            scheduled) before two calls to select. This helps in reducing the
            overhead of the select calls.

    config LCC_LOCAL_NODE_COUNT
        int "Number of 'local' LCC nodes"
        default 30
        help
            This controls how many trains will be supported concurrently by
            the command station.

    config LCC_SD_FSYNC_SEC
        int "Automatic fsync() interval (seconds)"
        default 10
        help
            For some file systems (SD only currently) it is required to call
            fsync() to force synchronize file changes to the file system due to
            small file size. In the case of the SD file system any file
            modification smaller than 512 bytes will remain in the in-memory
            cache and not be persisted to the SD card without a call to fsync()
            or close(). In the case of the LCC CDI file, the CDI file remains
            open for the lifetime of the application.

    config LCC_GC_DELAY_USEC
        int "GridConnect packet delay (microseconds)"
        default 1500 if LCC_HUB_USE_SELECT
        default 500
        depends on !LCC_TCP_STACK
        help
            How long (in microseconds) to buffer generated gridconnect data
            before sending off to the lowlevel system (such as a TCP socket).

    config LCC_GC_OUTBOUND_PACKET_LIMIT
        int "GridConnect packet count limit"
        default 2
        depends on !LCC_TCP_STACK
        help
            Number of pending buffers (of type string) in the outgoing hub on a
            per-connection basis. This limit ensures that we don't leak memory
            if the output socket cannot send the data fast enough.

    config LCC_TCP_STACK
        bool
        default n
        help
            By default the CS will use SimpleCanStack which supports both
            hardware CAN and TCP/IP GridConnect formatted packets. Enabling
            this option will shift to only support TCP/IP Binary packets.

    config LCC_USE_SELECT
        bool "Use select() for TCP/IP connections"
        default n
        help
            By enabling this option OpenMRN will use select() to detect when a
            TCP/IP connection is ready to be serviced. When not enabled two
            extra threads are created for servicing the TCP/IP connection.
endmenu

# note: nextion is not supported for v1.5.0
config NEXTION
    bool
    default n
    help
        The Nextion HMI interface provides a throttle interface
        directly connected to the ESP32 Command Station.

menu "Nextion HMI Configuration"
    depends on NEXTION

    config NEXTION_RX_PIN
        int "RX Pin (blue)"
        range 0 39
        default 14
        help
            This should be connected to the TX pin on the Nextion HMI,
            typically the blue wire.

    config NEXTION_TX_PIN
        int "TX Pin (yellow)"
        range 0 32
        default 27
        help
            This should be connected to the RX pin on the Nextion HMI,
            typically the yellow wire.

    config NEXTION_BAUD_RATE
        int "BAUD rate"
        default 115200
        help
            This must match the "bauds=XXX" value set in the Nextion
            HMI initialization event.

    choice NEXTION_UART
        bool "Hardware UART to use for the Nextion HMI"
        default NEXTION_UART_UART1
        config NEXTION_UART_UART1
            bool "UART1"
            depends on !OPS_RAILCOM_UART1 && !HC12_UART_UART1
        config NEXTION_UART_UART2
            bool "UART2"
            depends on !OPS_RAILCOM_UART2 && !HC12_UART_UART2
    endchoice

    config NEXTION_UART
        int
        default 1 if NEXTION_UART_UART1
        default 2 if NEXTION_UART_UART2

endmenu

# TODO: move this to LocoRoster component when created.
menu "Locomotive Roster"

    config ROSTER_AUTO_IDLE_NEW_LOCOS
        bool "Automatically Idle newly created locomotives"
        default n
        help
            By enabling this option, when any train is newly added to the
            roster it will default to automatic idle.

    config ROSTER_AUTO_CREATE_ENTRIES
        bool "Create a roster entry for new trains on first use"
        default y
        help
            By enabling this option, any train that is requested that does not
            already exist in the locomotive roster will be automatically added
            to the roster using DCC 128 speed step mode.

    config ROSTER_PERSISTENCE_INTERVAL_SEC
        int "Locomotive roster persistence interval (seconds)"
        default 30
        help
            Any changes to locomotives in the roster will be persisted after
            this many seconds to persistant storage (SPIFFS or SD). This is
            done to minimize the number of write operations when roster entries
            are modified.

endmenu

config ESP32CS_CDI_VERSION
    hex
    default 0x0150

config ESP32CS_HW_VERSION
    string
    default "ESP32-v1"

config ESP32CS_SW_VERSION
    string
    default "1.5.0"
```

## sdkconfig.defaults
```kconfig
#
# SDK configuration
#
CONFIG_ESPTOOLPY_FLASHSIZE_4MB=y
CONFIG_LOG_DEFAULT_LEVEL_WARN=y
CONFIG_HEAP_POISONING_LIGHT=y
CONFIG_PARTITION_TABLE_CUSTOM=y
CONFIG_PARTITION_TABLE_CUSTOM_FILENAME="ESP32CS-partitions.csv"
CONFIG_PARTITION_TABLE_FILENAME="ESP32CS-partitions.csv"
CONFIG_PARTITION_TABLE_TWO_OTA=n
CONFIG_PARTITION_TABLE_SINGLE_APP=n
CONFIG_COMPILER_STACK_CHECK_MODE_NORM=y
CONFIG_COMPILER_STACK_CHECK=y
CONFIG_COMPILER_OPTIMIZATION_LEVEL_RELEASE=y
CONFIG_COMPILER_OPTIMIZATION_SIZE=y
CONFIG_OPTIMIZATION_ASSERTIONS_ENABLED=y
CONFIG_COMPILER_OPTIMIZATION_ASSERTIONS_ENABLE=y
CONFIG_LOG_COLORS=n

#
# ESP32 Specific
#
# NOTE: ESP-IDF defaults to 160Mhz mode!
CONFIG_ESP32_DEFAULT_CPU_FREQ_240=y
CONFIG_ESP32_XTAL_FREQ_AUTO=y

#
# Bootloader configuratino
#
CONFIG_BOOTLOADER_LOG_LEVEL_WARN=y

#
# FreeRTOS configuration
#
CONFIG_FREERTOS_HZ=1000
CONFIG_FREERTOS_IDLE_TASK_STACKSIZE=1024
CONFIG_FREERTOS_WATCHPOINT_END_OF_STACK=y
CONFIG_FREERTOS_SUPPORT_STATIC_ALLOCATION=y

#
# libsodium
#
CONFIG_LIBSODIUM_USE_MBEDTLS_SHA=y

#
# LwIP configuration
#
CONFIG_LWIP_SO_RCVBUF=y
CONFIG_LWIP_LOCAL_HOSTNAME="esp32io"
# disable IRAM optimization due to https://github.com/espressif/esp-idf/issues/5734
CONFIG_LWIP_IRAM_OPTIMIZATION=n
CONFIG_LWIP_MAX_SOCKETS=16
CONFIG_LWIP_ETHARP_TRUST_IP_MAC=y
CONFIG_LWIP_DHCP_RESTORE_LAST_IP=y
CONFIG_LWIP_MAX_LISTENING_TCP=5
# Increase MSS to maximum value (1460)
CONFIG_LWIP_TCP_MSS=1460
# SNDBUF size is 6x MSS
CONFIG_LWIP_TCP_SND_BUF_DEFAULT=8760
# WND size is 10x MSS
CONFIG_LWIP_TCP_WND_DEFAULT=14600
# RECVMBOX is (WND / MSS) + 2
CONFIG_LWIP_TCP_RECVMBOX_SIZE=22
CONFIG_LWIP_TCPIP_RECVMBOX_SIZE=64
CONFIG_LWIP_TCPIP_TASK_STACK_SIZE=2560
CONFIG_LWIP_DHCP_DOES_ARP_CHECK=n

#
# Wi-Fi configuration
#
CONFIG_ESP32_WIFI_NVS_ENABLED=n
CONFIG_ESP32_WIFI_STATIC_RX_BUFFER_NUM=16
CONFIG_ESP32_WIFI_DYNAMIC_RX_BUFFER_NUM=48
CONFIG_ESP32_WIFI_DYNAMIC_TX_BUFFER_NUM=48
CONFIG_ESP32_WIFI_AMPDU_TX_ENABLED=y
CONFIG_ESP32_WIFI_TX_BA_WIN=32
CONFIG_ESP32_WIFI_AMPDU_RX_ENABLED=y
CONFIG_ESP32_WIFI_RX_BA_WIN=32
CONFIG_ESP32_WIFI_RX_IRAM_OPT=n
CONFIG_ESP32_WIFI_IRAM_OPT=n

#
# Task stack configuration
#
CONFIG_ESP_MAIN_TASK_STACK_SIZE=4096
CONFIG_ESP_IPC_TASK_STACK_SIZE=2048
CONFIG_ESP_SYSTEM_EVENT_TASK_STACK_SIZE=2816

#
# Watchdog configuration
#
CONFIG_ESP_INT_WDT_TIMEOUT_MS=1800
CONFIG_ESP_TASK_WDT=n

#
# FATFS configuration
#
CONFIG_FATFS_CODEPAGE_850=y
CONFIG_FATFS_LFN_HEAP=y
CONFIG_FATFS_LFN_STACK=y
CONFIG_FATFS_MAX_LFN=255

#
# SPIFFS configuration
#
CONFIG_SPIFFS_MAX_PARTITIONS=1

#
# mbedTLS configuration
#
CONFIG_MBEDTLS_DEFAULT_MEM_ALLOC=y
CONFIG_MBEDTLS_HARDWARE_MPI=y
CONFIG_MBEDTLS_TLS_CLIENT_ONLY=y
CONFIG_MBEDTLS_TLS_CLIENT=y
CONFIG_MBEDTLS_TLS_ENABLED=y
CONFIG_MBEDTLS_ECP_C=y
CONFIG_MBEDTLS_ECDH_C=y
CONFIG_MBEDTLS_ECDSA_C=y
CONFIG_MBEDTLS_ECP_DP_SECP192R1_ENABLED=y
CONFIG_MBEDTLS_ECP_DP_SECP224R1_ENABLED=y
CONFIG_MBEDTLS_ECP_DP_SECP256R1_ENABLED=y
CONFIG_MBEDTLS_ECP_DP_SECP384R1_ENABLED=y
CONFIG_MBEDTLS_ECP_DP_SECP521R1_ENABLED=y
CONFIG_MBEDTLS_ECP_DP_SECP192K1_ENABLED=y
CONFIG_MBEDTLS_ECP_DP_SECP224K1_ENABLED=y
CONFIG_MBEDTLS_ECP_DP_SECP256K1_ENABLED=y
CONFIG_MBEDTLS_ECP_DP_BP256R1_ENABLED=y
CONFIG_MBEDTLS_ECP_DP_BP384R1_ENABLED=y
CONFIG_MBEDTLS_ECP_DP_BP512R1_ENABLED=y
CONFIG_MBEDTLS_ECP_DP_CURVE25519_ENABLED=y
CONFIG_MBEDTLS_ECP_NIST_OPTIM=y
CONFIG_MBEDTLS_PSK_MODES=y

#
# WPA configuration
#
# NOTE: the option below requires CONFIG_MBEDTLS_HARDWARE_MPI to be enabled,
# see https://github.com/espressif/esp-idf/issues/5321 for details.
CONFIG_WPA_MBEDTLS_CRYPTO=y

#
# HTTP/DNS Server
#
CONFIG_HTTP_DNS_LIGHT_OPENMRN_LIB=n
```

## sdkconfig.defaults.esp32s2
```kconfig
#
# ESP32-S2 Specific
#
# NOTE: ESP-IDF defaults to 160Mhz mode!
CONFIG_ESP32S2_DEFAULT_CPU_FREQ_240=y
CONFIG_ESP32S2_DEBUG_OCDAWARE=n

#
# Compiler options
#
CONFIG_COMPILER_OPTIMIZATION_SIZE=y

#
# Ultra Low Power (ULP) Co-processor
#
CONFIG_ESP32S2_ULP_COPROC_ENABLED=y

#
# LwIP configuration
#
CONFIG_LWIP_MAX_SOCKETS=10

#
# TinyUSB Stack
#
CONFIG_TINYUSB=y

#
# Descriptor configuration
#
CONFIG_TINYUSB_DESC_MANUFACTURER_STRING="atanisoft.github.io"
CONFIG_TINYUSB_DESC_PRODUCT_STRING="ESP32 Command Station"
CONFIG_TINYUSB_DESC_CDC_STRING="ESP32 Command Station"
# end of Descriptor configuration

#
# Communication Device Class (CDC)
#
CONFIG_TINYUSB_CDC_ENABLED=y
CONFIG_TINYUSB_CDC_TX_BUFSIZE=128
# end of Communication Device Class (CDC)
# end of TinyUSB Stack
```

## sdkconfig.defaults.esp32s3
```kconfig
#
# SDK configuration
#
CONFIG_ESPTOOLPY_FLASHSIZE_8MB=y
CONFIG_PARTITION_TABLE_CUSTOM_FILENAME="ESP32CS-S3-partitions.csv"
CONFIG_PARTITION_TABLE_FILENAME="ESP32CS-S3-partitions.csv"

#
# ESP32S3-Specific
#
CONFIG_ESP32S3_DEFAULT_CPU_FREQ_240=y
CONFIG_ESP32S3_ULP_COPROC_ENABLED=y
CONFIG_ESP32S3_DEBUG_OCDAWARE=n
CONFIG_ESP32S3_SPIRAM_SUPPORT=y

#
# SPI RAM config
#
CONFIG_SPIRAM_TYPE_AUTO=y
CONFIG_SPIRAM=y
CONFIG_SPIRAM_USE_MALLOC=y
CONFIG_SPIRAM_MALLOC_ALWAYSINTERNAL=128
CONFIG_SPIRAM_TRY_ALLOCATE_WIFI_LWIP=y
CONFIG_SPIRAM_MALLOC_RESERVE_INTERNAL=0
CONFIG_SPIRAM_IGNORE_NOTFOUND=y

#
# ESP System Settings
#
CONFIG_ESP_CONSOLE_SECONDARY_USB_SERIAL_JTAG=y

#
# LWIP
#
CONFIG_LWIP_L2_TO_L3_COPY=y

#
# Compiler options
#
CONFIG_COMPILER_CXX_EXCEPTIONS=y

#
# TCP
#
CONFIG_LWIP_TCP_RECVMBOX_SIZE=32
CONFIG_LWIP_WND_SCALE=y
```

## sdkconfig.defaults.pcb
```kconfig
#
# CS PCB configuration
#
CONFIG_ESP32CS_FORCE_FACTORY_RESET_PIN=32
CONFIG_WIFI_MODE_SOFTAP=y
CONFIG_OPS_HBRIDGE_DRV8873_5A=y
CONFIG_OPS_HBRIDGE_ENABLE_PIN=17
CONFIG_OPS_HBRIDGE_SIGNAL_PIN=16
CONFIG_OPS_HBRIDGE_BRAKE_PIN=27
CONFIG_OPS_DCC_PREAMBLE_BITS=16
CONFIG_OPS_ADC_CHANNEL_0=y
CONFIG_OPS_RAILCOM=y
CONFIG_OPS_RAILCOM_ENABLE_PIN=12
CONFIG_OPS_RAILCOM_UART2=y
CONFIG_OPS_RAILCOM_UART=2
CONFIG_OPS_RAILCOM_UART_RX_PIN=26
CONFIG_OPS_RAILCOM_FEEDBACK_QUEUE=10
CONFIG_PROG_HBRIDGE_DRV880X=y
CONFIG_PROG_HBRIDGE_ENABLE_PIN=18
CONFIG_PROG_HBRIDGE_SIGNAL_PIN=19
CONFIG_PROG_ADC_CHANNEL_3=y
CONFIG_LCC_CAN_RX_PIN=4
CONFIG_LCC_CAN_TX_PIN=5
CONFIG_STATUS_LED=y
CONFIG_STATUS_LED_DATA_PIN=22
CONFIG_STATUS_LED_TYPE_TX1812=y
CONFIG_GPIO_OUTPUTS=n
CONFIG_GPIO_SENSORS=n
CONFIG_GPIO_S88=n
CONFIG_DISPLAY_SCL=21
CONFIG_DISPLAY_SDA=23
CONFIG_DISPLAY_OLED_RESET_PIN=0

CONFIG_THERMALMONITOR=y
CONFIG_THERMALMONITOR_TYPE_MCP9701=y
CONFIG_THERMALMONITOR_ZERO_MV=400
CONFIG_THERMALMONITOR_MV_PER_C=195
CONFIG_THERMALMONITOR_ADC_CHANNEL_7=y
```
