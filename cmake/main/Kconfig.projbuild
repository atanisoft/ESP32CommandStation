## components/DCCTurnoutManager/Kconfig.projbuild
```kconfig
# Log level constants from from components/OpenMRNLite/src/utils/logging.h
#
# ALWAYS      : -1
# FATAL       :  0
# LEVEL_ERROR :  1
# WARNING     :  2
# INFO        :  3
# VERBOSE     :  4
#
# Note that FATAL will cause the MCU to reboot!

menu "Turnout Management"

    config TURNOUT_CREATE_ON_DEMAND
        bool "Create turnouts on first use"
        default y
        help
            When this option is enabled, the first attempt to access a turnout
            will result in it being created and persisted. NOTE: This will only
            create DCC Turnouts. For OpenLCB based turnouts you will need to
            update them to provide the event mapping.

    config TURNOUT_PERSISTENCE_INTERVAL_SEC
        int "Number of seconds between automatic persistence of turnout list"
        default 30

    choice TURNOUT_LOGGING
        bool "Turnout Manager logging"
        default TURNOUT_LOGGING_MINIMAL
        config TURNOUT_LOGGING_VERBOSE
            bool "Verbose"
        config TURNOUT_LOGGING_MINIMAL
            bool "Minimal"
    endchoice
    config TURNOUT_LOG_LEVEL
        int
        default 4 if TURNOUT_LOGGING_MINIMAL
        default 3 if TURNOUT_LOGGING_VERBOSE
        default 5
endmenu
```

## components/Esp32HttpServer/Kconfig.projbuild
```kconfig
#
# Log level constants from from components/OpenMRNLite/src/utils/logging.h
#
# ALWAYS      : -1
# FATAL       :  0
# LEVEL_ERROR :  1
# WARNING     :  2
# INFO        :  3
# VERBOSE     :  4
#
# Note that FATAL will cause the MCU to reboot!

menu "HTTP/DNS Server"
    choice HTTP_DNS_LOGGING
        bool "DNS logging"
        default HTTP_DNS_LOGGING_MINIMAL
        config HTTP_DNS_LOGGING_VERBOSE
            bool "Verbose"
        config HTTP_DNS_LOGGING_MINIMAL
            bool "Minimal"
    endchoice
    config HTTP_DNS_LOG_LEVEL
        int
        default 4 if HTTP_DNS_LOGGING_MINIMAL
        default 3 if HTTP_DNS_LOGGING_VERBOSE
        default 5

    choice HTTP_SERVER_LOGGING
        bool "HttpRequest logging"
        default HTTP_SERVER_LOGGING_MINIMAL
        config HTTP_SERVER_LOGGING_VERBOSE
            bool "Verbose"
        config HTTP_SERVER_LOGGING_MINIMAL
            bool "Minimal"
    endchoice
    config HTTP_SERVER_LOG_LEVEL
        int
        default 4 if HTTP_SERVER_LOGGING_MINIMAL
        default 3 if HTTP_SERVER_LOGGING_VERBOSE
        default 5

    choice HTTP_REQ_LOGGING
        bool "HttpRequest logging"
        default HTTP_REQ_LOGGING_MINIMAL
        config HTTP_REQ_LOGGING_VERBOSE
            bool "Verbose"
        config HTTP_REQ_LOGGING_MINIMAL
            bool "Minimal"
    endchoice
    config HTTP_REQ_LOG_LEVEL
        int
        default 4 if HTTP_REQ_LOGGING_MINIMAL
        default 3 if HTTP_REQ_LOGGING_VERBOSE
        default 5

    choice HTTP_RESP_LOGGING
        bool "HttpRequest logging"
        default HTTP_RESP_LOGGING_MINIMAL
        config HTTP_RESP_LOGGING_VERBOSE
            bool "Verbose"
        config HTTP_RESP_LOGGING_MINIMAL
            bool "Minimal"
    endchoice
    config HTTP_RESP_LOG_LEVEL
        int
        default 4 if HTTP_RESP_LOGGING_MINIMAL
        default 3 if HTTP_RESP_LOGGING_VERBOSE
        default 5
    
    choice HTTP_REQ_FLOW_LOGGING
        bool "HttpRequestFlow logging"
        default HTTP_REQ_FLOW_LOGGING_MINIMAL
        config HTTP_REQ_FLOW_LOGGING_VERBOSE
            bool "Verbose"
        config HTTP_REQ_FLOW_LOGGING_MINIMAL
            bool "Minimal"
    endchoice
    config HTTP_REQ_FLOW_LOG_LEVEL
        int
        default 4 if HTTP_REQ_FLOW_LOGGING_MINIMAL
        default 3 if HTTP_REQ_FLOW_LOGGING_VERBOSE
        default 5

    choice HTTP_WS_LOGGING
        bool "WebSocket logging"
        default HTTP_WS_LOGGING_MINIMAL
        config HTTP_WS_LOGGING_VERBOSE
            bool "Verbose"
        config HTTP_WS_LOGGING_MINIMAL
            bool "Minimal"
    endchoice
    config HTTP_WS_LOG_LEVEL
        int
        default 4 if HTTP_WS_LOGGING_MINIMAL
        default 3 if HTTP_WS_LOGGING_VERBOSE
        default 5

endmenu
```

## components/GPIO/Kconfig.projbuild
```kconfig
config GPIO_OUTPUTS
    bool "Enable GPIO pins to be used as outputs"
    default y
    help
        Enabling this option will allow usage of any free GPIO pin to be
        used as a controlled output.

config GPIO_SENSORS
    bool "Enable GPIO pins to be used as sensors"
    default y
    help
        Enabling this option will allow usage of any free GPIO pin to be
        used as a polled input.

config GPIO_S88
    bool "Enable S88 Sensor functionality"
    default n
    depends on GPIO_SENSORS
    help
        S88 (S88-n) is a feedback bus used primarily for occupancy
        detection but can be used for any digital input purposes. This
        module follows the S88-n timing as documented on http://www.s88-n.eu/

menu "GPIO"
    config ALLOW_USAGE_OF_RESTRICTED_GPIO_PINS
        bool "Allow usage of restricted GPIO pins"
        default n
        depends on GPIO_OUTPUTS || GPIO_SENSORS || GPIO_S88
        help
            Enables usage of the following pins for sensors and outputs
            0 - Bootstrap / Firmware Flash Download
            1 - UART0 TX
            2 - Bootstrap / Firmware Flash Download
            3 - UART0 RX
            5 - Bootstrap
            6, 7, 8, 9, 10, 11 - flash pins
            12, 15 - Bootstrap / SD pins

# Log level constants from from components/OpenMRNLite/src/utils/logging.h
#
# ALWAYS      : -1
# FATAL       :  0
# LEVEL_ERROR :  1
# WARNING     :  2
# INFO        :  3
# VERBOSE     :  4
#
# Note that FATAL will cause the MCU to reboot!

    choice GPIO_OUTPUT_LOGGING
        bool "GPIO Outputs logging"
        default GPIO_OUTPUT_LOGGING_MINIMAL
        depends on GPIO_OUTPUTS
        config GPIO_OUTPUT_LOGGING_VERBOSE
            bool "Verbose"
        config GPIO_OUTPUT_LOGGING_MINIMAL
            bool "Minimal"
    endchoice
    config GPIO_OUTPUT_LOG_LEVEL
        int
        depends on GPIO_OUTPUTS
        default 4 if GPIO_OUTPUT_LOGGING_MINIMAL
        default 3 if GPIO_OUTPUT_LOGGING_VERBOSE
        default 5

    choice GPIO_SENSOR_LOGGING
        bool "GPIO Sensors logging"
        default GPIO_SENSOR_LOGGING_MINIMAL
        depends on GPIO_SENSORS
        config GPIO_SENSOR_LOGGING_VERBOSE
            bool "Verbose"
        config GPIO_SENSOR_LOGGING_MINIMAL
            bool "Minimal"
    endchoice
    config GPIO_SENSOR_LOG_LEVEL
        int
        depends on GPIO_SENSORS
        default 4 if GPIO_SENSOR_LOGGING_MINIMAL
        default 3 if GPIO_SENSOR_LOGGING_VERBOSE
        default 5
endmenu

menu "Remote Sensors"
    depends on GPIO_SENSORS

    config REMOTE_SENSORS_DECAY
        int "Number of milliseconds until a remote sensor will automatically clear"
        default 60000
        help
            If a remote sensor does not report it's state within this
            number of milliseconds it will automatically be deactivated.

    config REMOTE_SENSORS_FIRST_SENSOR
        int "First ID to assign remote sensors"
        default 100
        help
            All sensors must have a unique ID number assigned to them, this
            value allows configuring what the first sensor ID will be for
            any remote sensors that report to the command station.
endmenu

menu "S88 Sensors"
    depends on GPIO_S88

    config GPIO_S88_CLOCK_PIN
        int "S88 Clock pin"
        range 0 32
        default 17
        help
            This pin is used to advance the sensor input data to the next
            sensor.

    config GPIO_S88_RESET_PIN
        int "S88 Reset pin"
        range -1 32
        default 16
        help
            This pin will be sent a pulse when initializing the read cycle
            for the sensors on the bus. This behavior can be disabled by
            setting this to -1.

    config GPIO_S88_LOAD_PIN
        int "S88 Load pin"
        range 0 32
        default 27
        help
            This pin is used to tell the sensors on the bus to load their
            current state for reading.

    config GPIO_S88_FIRST_SENSOR
        int "First S88 sensor ID"
        range 0 512
        default 512
        help
            This will be used for the first sensor bus and subsequent buses
            will start at the next sequential block of IDs. The block size
            is defined by the sensors per bus count below.

    config GPIO_S88_SENSORS_PER_BUS
        int "S88 sensors per bus"
        range 8 512
        default 512
        help
            This is the maximum number of inputs that are supported per
            bus. In most cases the default of 512 is sufficient but if
            you have smaller buses and want to have sensor IDs more
            closely indexed this value can be adjusted to a lower value.

    choice GPIO_S88_SENSOR_LOGGING
        bool "S88 Sensors logging"
        default GPIO_S88_SENSOR_LOGGING_MINIMAL
        depends on GPIO_S88
        config GPIO_S88_SENSOR_LOGGING_VERBOSE
            bool "Verbose"
        config GPIO_S88_SENSOR_LOGGING_MINIMAL
            bool "Minimal"
    endchoice
    config GPIO_S88_SENSOR_LOG_LEVEL
        int
        depends on GPIO_S88
        default 4 if GPIO_S88_SENSOR_LOGGING_MINIMAL
        default 3 if GPIO_S88_SENSOR_LOGGING_VERBOSE
        default 5

endmenu
```

## components/HC12/Kconfig.projbuild
```kconfig
config HC12
    bool "Enable HC12 Radio interface"
    default n
    help
        The HC12 is a radio receiver that was previously used by some
        throttles to wirelessly send packet data to the ESP32 Command
        Station.

menu "HC12 Radio"
    depends on HC12

    config HC12_RX_PIN
        int "RX pin"
        range 0 39

    config HC12_TX_PIN
        int "TX pin"
        range 0 32

    choice HC12_UART
        bool "UART"
        default HC12_UART_UART1
        config HC12_UART_UART1
            bool "UART1"
            depends on !OPS_RAILCOM_UART1
        config HC12_UART_UART2
            bool "UART2"
            depends on !OPS_RAILCOM_UART2
    endchoice

    config HC12_UART
        int
        default 1 if HC12_UART_UART1
        default 2 if HC12_UART_UART2

    config HC12_BAUD_RATE
        int "BAUD rate for HC12 Radio"
        default 19200

    config HC12_BUFFER_SIZE
        int
        default 256
endmenu
```

## components/JmriInterface/Kconfig.projbuild
```kconfig
config JMRI
    bool "Enable Legacy JMRI DCC++ Interface"
    default y
    depends on !WIFI_MODE_DISABLED

menu "Legacy JMRI DCC++ Interface"
    depends on JMRI

    config JMRI_LISTENER_PORT
        int "JMRI Listener port"
        default 2560

    config JMRI_MDNS_SERVICE_NAME
        string "mDNS service name"
        default "_esp32cs._tcp"
endmenu
```

## components/LCCTrainSearchProtocol/Kconfig.projbuild
```kconfig
menu "LCC Train Search"
###############################################################################
#
# Log level constants from from components/OpenMRNLite/src/utils/logging.h
#
# ALWAYS      : -1
# FATAL       :  0
# LEVEL_ERROR :  1
# WARNING     :  2
# INFO        :  3
# VERBOSE     :  4
#
# Note that FATAL will cause the MCU to reboot!
#
###############################################################################
    choice LCC_TSP_LOGGING
        bool "Log level"
        default LCC_TSP_LOGGING_MINIMAL
        config LCC_TSP_LOGGING_VERBOSE
            bool "Verbose"
        config LCC_TSP_LOGGING_MINIMAL
            bool "Minimal"
    endchoice
    config LCC_TSP_LOG_LEVEL
        int
        default 4 if LCC_TSP_LOGGING_MINIMAL
        default 3 if LCC_TSP_LOGGING_VERBOSE
        default 5
endmenu
```
