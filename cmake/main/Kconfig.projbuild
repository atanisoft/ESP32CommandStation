## components/DCCSignalGenerator/Kconfig.projbuild
```kconfig
menu "DCC Signal"
    menu "OPS"
        config OPS_TRACK_NAME
            string "Name"
            default "OPS"

        config OPS_ENERGIZE_ON_STARTUP
            bool "Energize track upon startup"
            default n
            help
                Enabling this option will energize the OPS track
                automatically upon startup of the command station.
    
        choice OPS_HBRIDGE_TYPE
            bool "H-Bridge type"
            default OPS_HBRIDGE_L298
            help
                The following motor driver modules are supported:
                L298           : Arduino Motor shield Rev3 based on the L298 chip. Max Output 2A per channel https://store.arduino.cc/usa/arduino-motor-shield-rev3
                LMD18200       : Texas Instruments LMD18200 55V 3A h-bridge. http://www.ti.com/lit/ds/symlink/lmd18200.pdf
                DRV880x        : Texas Instruments DRV880x 36V 2.8A h-bridge. https://www.ti.com/lit/ds/symlink/drv8800.pdf
                DRV8873        : Texas Instruments DRV8873 36V 10A h-bridge. https://www.ti.com/lit/ds/symlink/drv8873.pdf
                DRV8873_5A     : Texas Instruments DRV8873 36V 10A h-bridge (limited to 5A). https://www.ti.com/lit/ds/symlink/drv8873.pdf
                POLOLU         : Pololu MC33926 Motor Driver (shield or carrier). Max Output 2.5A per channel https://www.pololu.com/product/1213 / https://www.pololu.com/product/2503
                BTS7960B_5A    : Infineon Technologies BTS 7960 Motor Driver Module. Max Output 5A (43A actual max) https://www.infineon.com/dgdl/bts7960b-pb-final.pdf
                BTS7960B_10A   : Infineon Technologies BTS 7960 Motor Driver Module. Max Output 10A (43A actual max) https://www.infineon.com/dgdl/bts7960b-pb-final.pdf
            config OPS_HBRIDGE_L298
                bool "L298"
            config OPS_HBRIDGE_LMD18200
                bool "LMD18200"
            config OPS_HBRIDGE_DRV880X
                bool "DRV880x"
            config OPS_HBRIDGE_DRV8873
                bool "DRV8873"
            config OPS_HBRIDGE_DRV8873_5A
                bool "DRV8873 (5A limit)"
            config OPS_HBRIDGE_POLOLU
                bool "Pololu MC33926"
            config OPS_HBRIDGE_BTS7960B_5A
                bool "BTS7960B (5A limit)"
            config OPS_HBRIDGE_BTS7960B_10A
                bool "BTS7960B (10A limit)"
        endchoice

        config OPS_HBRIDGE_TYPE_NAME
            string
            default "L298" if OPS_HBRIDGE_L298
            default "LMD18200" if OPS_HBRIDGE_LMD18200
            default "DRV880x" if OPS_HBRIDGE_DRV880X
            default "DRV8873" if OPS_HBRIDGE_DRV8873 || OPS_HBRIDGE_DRV8873_5A
            default "MC33926" if OPS_HBRIDGE_POLOLU
            default "BTS7960B" if OPS_HBRIDGE_BTS7960B_5A
            default "BTS7960B" if OPS_HBRIDGE_BTS7960B_10A

        config OPS_HBRIDGE_MAX_MILLIAMPS
            int
            default 2000 if OPS_HBRIDGE_L298
            default 3000 if OPS_HBRIDGE_LMD18200
            default 2800 if OPS_HBRIDGE_DRV880X 
            default 10000 if OPS_HBRIDGE_DRV8873 || OPS_HBRIDGE_DRV8873_5A
            default 2500 if OPS_HBRIDGE_POLOLU
            default 43000 if OPS_HBRIDGE_BTS7960B_5A
            default 43000 if OPS_HBRIDGE_BTS7960B_10A

        config OPS_HBRIDGE_LIMIT_MILLIAMPS
            int
            default 2000 if OPS_HBRIDGE_L298
            default 3000 if OPS_HBRIDGE_LMD18200
            default 2800 if OPS_HBRIDGE_DRV880X
            default 10000 if OPS_HBRIDGE_DRV8873
            default 5000 if OPS_HBRIDGE_DRV8873_5A
            default 2500 if OPS_HBRIDGE_POLOLU
            default 5000 if OPS_HBRIDGE_BTS7960B_5A
            default 10000 if OPS_HBRIDGE_BTS7960B_10A

        config OPS_HBRIDGE_ENABLE_PIN
            int "H-Bridge enable/pwm pin"
            default 25
            range 2 33
            help
                This pin will be HIGH when the H-Bridge output should be
                enabled and will be LOW when it should be disabled. This
                pin should typically be connected to the PWM input of the
                H-Bridge IC.

        config OPS_HBRIDGE_SIGNAL_PIN
            int "H-Bridge signal/direction pin"
            default 19
            range 0 33
            help
                This pin will transition HIGH/LOW based on the DCC signal
                data being generated by the command station. This should
                typically be connected to the direction pin on the H-Bridge
                IC.

        config OPS_HBRIDGE_BRAKE_PIN
            int "H-Bridge brake pin"
            default 0
            range 0 33
            depends on OPS_HBRIDGE_LMD18200 || OPS_HBRIDGE_DRV880X || OPS_HBRIDGE_DRV8873 || OPS_HBRIDGE_DRV8873_5A
            help
                This pin should be connected to the H-Bridge BRAKE pin
                input and is used to put the H-Bridge into a "coast" mode.
        
        choice OPS_HBRIDGE_CURRENT_SENSE_PIN
            bool "H-Bridge current sense pin"
            help
                This is used for short circuit detection.
            default OPS_ADC_CHANNEL_0
            config OPS_ADC_CHANNEL_0
                bool "ADC1 Channel 0 (GPIO 36)"
            config OPS_ADC_CHANNEL_1
                bool "ADC1 Channel 1 (GPIO 37)"
                help
                    Note this pin may not be exposed on all ESP32 modules
            config OPS_ADC_CHANNEL_2
                bool "ADC1 Channel 2 (GPIO 38)"
                help
                    Note this pin may not be exposed on all ESP32 modules
            config OPS_ADC_CHANNEL_3
                bool "ADC1 Channel 3 (GPIO 39)"
            config OPS_ADC_CHANNEL_4
                bool "ADC1 Channel 4 (GPIO 32)"
            config OPS_ADC_CHANNEL_5
                bool "ADC1 Channel 5 (GPIO 33)"
            config OPS_ADC_CHANNEL_6
                bool "ADC1 Channel 6 (GPIO 34)"
            config OPS_ADC_CHANNEL_7
                bool "ADC1 Channel 7 (GPIO 35)"
        endchoice

        config OPS_ADC
            int
            default 0 if OPS_ADC_CHANNEL_0
            default 1 if OPS_ADC_CHANNEL_1
            default 2 if OPS_ADC_CHANNEL_2
            default 3 if OPS_ADC_CHANNEL_3
            default 4 if OPS_ADC_CHANNEL_4
            default 5 if OPS_ADC_CHANNEL_5
            default 6 if OPS_ADC_CHANNEL_6
            default 7 if OPS_ADC_CHANNEL_7

        config OPS_RAILCOM
            bool "Enable RailCom detector"
            default n
            help
                Enabling this functionality will cause the command station
                to interrupt the DCC signal between packets to
                receive/decode any RailCom data that decoders may be
                writing to the rails.

        config OPS_RAILCOM_ENABLE_PIN
            int "RailCom detector enable pin"
            range 2 33
            default 12
            depends on OPS_RAILCOM
            help
                This pin will go HIGH when the RailCom detector circuitry
                should be active and will go LOW when it should be
                disabled.

        choice OPS_RAILCOM_UART
            bool "RailCom UART"
            default OPS_RAILCOM_UART2
            depends on OPS_RAILCOM
            config OPS_RAILCOM_UART1
                bool "UART1"
            config OPS_RAILCOM_UART2
                bool "UART2"
        endchoice

        config OPS_RAILCOM_UART
            int
            default 1 if OPS_RAILCOM_UART1
            default 2 if OPS_RAILCOM_UART2
            depends on OPS_RAILCOM

        config OPS_RAILCOM_UART_RX_PIN
            int "RailCom UART RX pin"
            range 0 39
            depends on OPS_RAILCOM
            help
                This pin should be connected to the RailCom detector data
                output.

        config OPS_RAILCOM_DUMP_PACKETS
            bool "Display all RailCom packets as they are received"
            default n
            depends on OPS_RAILCOM

        config OPS_RAILCOM_FEEDBACK_QUEUE
            int "RailCom Feedback queue size"
            default 10
            depends on OPS_RAILCOM
            help
                This controls the number of RailCom feedback packets to
                pre-allocate for receiving feedback from RailCom enabled DCC
                decoders. This value must be larger than the OPS DCC packet
                queue size.

        config OPS_DCC_PREAMBLE_BITS
            int "DCC packet preamble bits"
            range 11 20
            default 11
            help
                This controls the number of "1" bits to be transmitted
                before the payload of the DCC packet. If RailCom is enabled
                this must be at least 16.

        config OPS_PACKET_QUEUE_SIZE
            int "OPS Track DCC Packet queue size"
            default 5
            range 5 20
            help
                This is the number of raw packets to allow for outbound
                transmission to the track. Generally this does not need to
                be very large and should be around the same size as
                DCC_PACKET_POOL_SIZE.
    endmenu

    menu "PROG"
        config PROG_TRACK_NAME
            string "Name"
            default "PROG"

        choice PROG_HBRIDGE_TYPE
            bool "H-Bridge type"
            default PROG_HBRIDGE_L298
            help
                The following motor driver modules are supported:
                L298           : Arduino Motor shield Rev3 based on the L298 chip. Max Output 2A per channel https://store.arduino.cc/usa/arduino-motor-shield-rev3
                LMD18200       : Texas Instruments LMD18200 55V 3A h-bridge. http://www.ti.com/lit/ds/symlink/lmd18200.pdf
                DRV880x        : Texas Instruments DRV880x 36V 2.8A h-bridge. https://www.ti.com/lit/ds/symlink/drv8800.pdf
                DRV8873        : Texas Instruments DRV8873 36V 10A h-bridge. https://www.ti.com/lit/ds/symlink/drv8873.pdf
                DRV8873_5A     : Texas Instruments DRV8873 36V 10A h-bridge (limited to 5A). https://www.ti.com/lit/ds/symlink/drv8873.pdf
                POLOLU         : Pololu MC33926 Motor Driver (shield or carrier). Max Output 2.5A per channel https://www.pololu.com/product/1213 / https://www.pololu.com/product/2503
                BTS7960B_5A    : Infineon Technologies BTS 7960 Motor Driver Module. Max Output 5A (43A actual max) https://www.infineon.com/dgdl/bts7960b-pb-final.pdf
                BTS7960B_10A   : Infineon Technologies BTS 7960 Motor Driver Module. Max Output 10A (43A actual max) https://www.infineon.com/dgdl/bts7960b-pb-final.pdf
            config PROG_HBRIDGE_L298
                bool "L298"
            config PROG_HBRIDGE_LMD18200
                bool "LMD18200"
            config PROG_HBRIDGE_DRV880X
                bool "DRV880x"
            config PROG_HBRIDGE_DRV8873
                bool "DRV8873"
            config PROG_HBRIDGE_DRV8873_5A
                bool "DRV8873 (5A limit)"
            config PROG_HBRIDGE_POLOLU
                bool "Pololu MC33926"
            config PROG_HBRIDGE_BTS7960B_5A
                bool "BTS7960B (5A limit)"
            config PROG_HBRIDGE_BTS7960B_10A
                bool "BTS7960B (10A limit)"
        endchoice

        config PROG_HBRIDGE_TYPE_NAME
            string
            default "L298" if PROG_HBRIDGE_L298
            default "LMD18200" if PROG_HBRIDGE_LMD18200
            default "DRV880x" if PROG_HBRIDGE_DRV880X
            default "DRV8873" if PROG_HBRIDGE_DRV8873 || PROG_HBRIDGE_DRV8873_5A
            default "MC33926" if PROG_HBRIDGE_POLOLU
            default "BTS7960B" if PROG_HBRIDGE_BTS7960B_5A
            default "BTS7960B" if PROG_HBRIDGE_BTS7960B_10A

        config PROG_HBRIDGE_MAX_MILLIAMPS
            int
            default 2000 if PROG_HBRIDGE_L298
            default 3000 if PROG_HBRIDGE_LMD18200
            default 2800 if PROG_HBRIDGE_DRV880X
            default 10000 if PROG_HBRIDGE_DRV8873 || PROG_HBRIDGE_DRV8873_5A
            default 2500 if PROG_HBRIDGE_POLOLU
            default 43000 if PROG_HBRIDGE_BTS7960B_5A || PROG_HBRIDGE_BTS7960B_10A

        config PROG_HBRIDGE_ENABLE_PIN
            int "H-Bridge enable pin"
            default 23
            range 2 33
            help
                This pin will be HIGH when the H-Bridge output should be
                enabled and will be LOW when it should be disabled. This
                pin should typically be connected to the PWM input of the
                H-Bridge IC.

        config PROG_HBRIDGE_SIGNAL_PIN
            int "H-Bridge signal pin"
            default 18
            range 0 33
            help
                This pin will transition HIGH/LOW based on the DCC signal
                data being generated by the command station. This should
                typically be connected to the direction pin on the H-Bridge
                IC.

        choice PROG_HBRIDGE_CURRENT_SENSE_PIN
        bool "H-Bridge current sense pin"
            default PROG_ADC_CHANNEL_3
            help
                This pin must be connected to the H-Bridge current sense
                output pin, failure to do so will result in no ability to
                read/write/validate CVs successfully.
            config PROG_ADC_CHANNEL_0
                bool "ADC1 Channel 0 (GPIO 36)"
                depends on !OPS_ADC_CHANNEL_0
            config PROG_ADC_CHANNEL_1
                bool "ADC1 Channel 1 (GPIO 37)"
                help
                    Note this pin may not be exposed on all ESP32 modules
                depends on !OPS_ADC_CHANNEL_1
            config PROG_ADC_CHANNEL_2
                bool "ADC1 Channel 2 (GPIO 38)"
                help
                    Note this pin may not be exposed on all ESP32 modules
                depends on !OPS_ADC_CHANNEL_2
            config PROG_ADC_CHANNEL_3
                bool "ADC1 Channel 3 (GPIO 39)"
                depends on !OPS_ADC_CHANNEL_3
            config PROG_ADC_CHANNEL_4
                bool "ADC1 Channel 4 (GPIO 32)"
                depends on !OPS_ADC_CHANNEL_4
            config PROG_ADC_CHANNEL_5
                bool "ADC1 Channel 5 (GPIO 33)"
                depends on !OPS_ADC_CHANNEL_5
            config PROG_ADC_CHANNEL_6
                bool "ADC1 Channel 6 (GPIO 34)"
                depends on !OPS_ADC_CHANNEL_6
            config PROG_ADC_CHANNEL_7
                bool "ADC1 Channel 7 (GPIO 35)"
                depends on !OPS_ADC_CHANNEL_7
        endchoice

        config PROG_ADC
            int
            default 0 if PROG_ADC_CHANNEL_0
            default 1 if PROG_ADC_CHANNEL_1
            default 2 if PROG_ADC_CHANNEL_2
            default 3 if PROG_ADC_CHANNEL_3
            default 4 if PROG_ADC_CHANNEL_4
            default 5 if PROG_ADC_CHANNEL_5
            default 6 if PROG_ADC_CHANNEL_6
            default 7 if PROG_ADC_CHANNEL_7

        config PROG_DCC_PREAMBLE_BITS
            int "DCC packet preamble bits"
            range 22 75
            default 22
            help
                This controls the number of "1" bits to be transmitted
                before the payload of the DCC packet. Some decoders may
                require more "1" bits for proper operation, this is usually
                only a problem with some brands of sound decoders.

        config PROG_PACKET_QUEUE_SIZE
            int "PROG Track DCC Packet queue size"
            default 5
            range 5 20
            help
                This is the number of raw packets to allow for outbound
                transmission to the track. Generally this does not need to
                be very large and should be around the same size as
                DCC_PACKET_POOL_SIZE.
    endmenu

    choice ADC_ATTENUATION
        bool "ADC attenuation"
        default ADC_ATTEN_DB_11
        help
            This setting controls the expected voltage on the current
            sense input pins.
            0 dB attenuation gives full-scale voltage 1.1V
            2.5 dB attenuation gives full-scale voltage 1.5V
            6 dB attenuation gives full-scale voltage 2.2V
            11 dB attenuation gives full-scale voltage 3.9V
        config ADC_ATTEN_DB_0
            bool "0 dB (1.1V max)"
        config ADC_ATTEN_DB_2_5
            bool "2.5 dB (1.5V max)"
        config ADC_ATTEN_DB_6
            bool "6 dB (2.2V max)"
        config ADC_ATTEN_DB_11
            bool "11 dB (3.9V max)"
    endchoice

    config ADC_ATTENUATION
        int
        default 0 if ADC_ATTEN_DB_0
        default 1 if ADC_ATTEN_DB_2_5
        default 2 if ADC_ATTEN_DB_6
        default 3 if ADC_ATTEN_DB_11

    config ADC_AVERAGE_READING_COUNT
        int
        default 32

    config DCC_PACKET_POOL_SIZE
        int "Maximum number of DCC packets to queue"
        default 5
        range 2 20
        help
            Declares the maximum number of DCC packets to allow for the
            track, generally this does not need to be very large and the
            default value should be sufficient.

###############################################################################
#
# Log level constants from from components/OpenMRNLite/src/utils/logging.h
#
# ALWAYS      : -1
# FATAL       :  0
# LEVEL_ERROR :  1
# WARNING     :  2
# INFO        :  3
# VERBOSE     :  4
#
# Note that FATAL will cause the MCU to reboot!
#
###############################################################################
    choice DCC_RMT_LOGGING
        bool "DCC RMT logging"
        default DCC_RMT_LOGGING_MINIMAL
        config DCC_RMT_LOGGING_VERBOSE
            bool "Verbose"
        config DCC_RMT_LOGGING_MINIMAL
            bool "Minimal"
    endchoice
    config DCC_RMT_LOG_LEVEL
        int
        default 4 if DCC_RMT_LOGGING_MINIMAL
        default 3 if DCC_RMT_LOGGING_VERBOSE
        default 5

    config DCC_HBRIDGE_USAGE_REPORT_INTERVAL
        int "Usage report interval (seconds)"
        default 30
        range 15 300

    config DCC_HBRIDGE_OVERCURRENT_BEFORE_SHUTDOWN
        int "Number of consecutive over-current reads before shutdown"
        default 3

###############################################################################
#
# These options should be used with extreme care as they will alter how the DCC
# signal is generated. This is most useful when debugging the DCC signal using
# LEDs to visually inspect the signal without a logic analyzer or oscilloscope.
#
# When using LEDs to debug the DCC signal it is necessary to slow the signal.
# Enabling DCC_RMT_USE_REF_CLOCK and setting DCC_RMT_DIVIDER to at least 160 or
# even 240 should be sufficient to slow the DCC signal for visible changes in
# the LEDs. If this is not slow enough the pulse lengths can be increased.
#
###############################################################################
    menu "Advanced options"
        config DCC_RMT_HIGH_FIRST
            bool "Generate HIGH,LOW signal"
            default y
            help
                When enabled this will cause the RMT to generate a HIGH then
                LOW signal on the output PIN. When disabled it will be LOW then
                HIGH.

        config DCC_RMT_USE_REF_CLOCK
            bool "Use REF_TICK clock source (1Mhz)"
            default n
            help
                When enabled this will cause the RMT to use the REF_TICK clock
                as the clock source, this is a 1Mhz clock. By default the RMT
                will use the APB clock which is an 80Mhz clock.

        config DCC_RMT_CLOCK_DIVIDER
            int "RMT clock divider"
            range 1 255
            default 1 if DCC_RMT_USE_REF_CLOCK
            default 80
            help
                This is the clock divider used to calculate the tick rate. With
                the APB clock (80Mhz) the default value of 80 will provide
                approximately one microsecond per tick. With REF_TICK enabled
                the default value of one will provide a similar one microsecond
                tick.

        config DCC_RMT_TICKS_ZERO_PULSE
            int "DCC ZERO RMT tick count"
            range 95 9900
            default 100
            help
                This controls how many RMT ticks will be used for each half of
                a ZERO bit being transmitted by the RMT.
                Warning: Depending on the h-bridge in use it may be necessary
                to pad this value with one or two ticks to allow for transition
                of HIGH to LOW. The default value accounts for this variance of
                the h-bridges.

        config DCC_RMT_TICKS_ONE_PULSE
            int "DCC ONE RMT tick count"
            range 55 61
            default 58
            help
                This controls how many RMT ticks will be used for each half of
                a ONE bit being transmitted by the RMT.
                Warning: Depending on the h-bridge in use it may be necessary
                to pad this value with one or two ticks to allow for transition
                of HIGH to LOW. The default value accounts for this variance of
                the h-bridges.
    endmenu
endmenu
```
