## components/Configuration/Kconfig.projbuild
```kconfig
menu "WiFi Configuration"
    choice WIFI_MODE
        bool "WiFi Mode"
        default WIFI_MODE_SOFTAP
        config WIFI_MODE_STATION
            bool "Connect to SSID"
        config WIFI_MODE_SOFTAP
            bool "Create SoftAP"
        config WIFI_MODE_SOFTAP_STATION
            bool "Connect to SSID and create SoftAP"
        config WIFI_MODE_OFF
            bool "Disabled"
    endchoice

    config WIFI_MODE
        int
        default 0 if WIFI_MODE_OFF
        default 1 if WIFI_MODE_STATION
        default 2 if WIFI_MODE_SOFTAP
        default 3 if WIFI_MODE_SOFTAP_STATION

    config WIFI_HOSTNAME_PREFIX
        string "Hostname prefix"
        default "esp32cs_"
        help
            The OpenLCB node identifier will be appended to this value, ie:
            esp32cs_0502010300000.

    config WIFI_SOFTAP_SSID
        string "SoftAP SSID"
        default "esp32csap"
        depends on WIFI_MODE_SOFTAP || WIFI_MODE_SOFTAP_STATION

    config WIFI_SOFTAP_PASSWORD
        string "SoftAP Password"
        default "esp32csap"
        depends on WIFI_MODE_SOFTAP || WIFI_MODE_SOFTAP_STATION

    config WIFI_SOFTAP_CHANNEL
        int "SoftAP Channel"
        default 1
        range 1 14
        depends on WIFI_MODE_SOFTAP || WIFI_MODE_SOFTAP_STATION
        help
            This configures the channel that will be used by the SoftAP. There
            are fourteen channels available to pick from and some are better
            than others. The best channels to pick from are: 1, 6, 11 since
            these do not overlap with other channels.

    config WIFI_STATION_SSID
        string "Station SSID"
        depends on WIFI_MODE_STATION || WIFI_MODE_SOFTAP_STATION

    config WIFI_STATION_PASSWORD
        string "Station Password"
        depends on WIFI_MODE_STATION || WIFI_MODE_SOFTAP_STATION

    choice WIFI_IP_TYPE
        bool "WiFi IP"
        default WIFI_IP_DHCP
        depends on WIFI_MODE_STATION || WIFI_MODE_SOFTAP_STATION
        config WIFI_IP_DHCP
            bool "DHCP"
        config WIFI_IP_STATIC
            bool "Static"
    endchoice

    config WIFI_STATIC_IP_ADDRESS
        string "IP address"
        default "10.0.0.155"
        depends on WIFI_IP_STATIC

    config WIFI_STATIC_IP_GATEWAY
        string "Gateway IP address"
        default "10.0.0.1"
        depends on WIFI_IP_STATIC

    config WIFI_STATIC_IP_SUBNET
        string "Subnet mask"
        default "255.255.255.0"
        depends on WIFI_IP_STATIC

    config WIFI_STATIC_IP_DNS
        string "Primary DNS address"
        default "8.8.8.8"
        depends on WIFI_IP_STATIC

    config SNTP
        bool "Enable SNTP synchronization"
        default n
        depends on WIFI_MODE_STATION || WIFI_MODE_SOFTAP_STATION
        help
            By enabling this option the ESP32 will attempt to synchronize the
            system time with an external SNTP server once per hour.

    config SNTP_SERVER
        string "SNTP Server"
        default "pool.ntp.org"
        depends on SNTP

    config TIMEZONE
        string "Timezone"
        default "UTC0"
        depends on SNTP
        help
            This is the timezone that the ESP32 OpenLCB IO Board is running in.
            The value must follow POSIX notation.
            A few common values:
            * PST8PDT,M3.2.0,M11.1.0 -- UTC-8 with automatic DST adjustment
            * MST7MDT,M3.2.0,M11.1.0 -- UTC-7 with automatic DST adjustment
            * CST6CDT,M3.2.0,M11.1.0 -- UTC-6 with automatic DST adjustment
            * EST5EDT,M3.2.0,M11.1.0 -- UTC-5 with automatic DST adjustment
            A complete list can be seen here in the second column:
            https://github.com/nayarsystems/posix_tz_db/blob/master/zones.csv

    config WIFI_DEBUG_OUTPUT
        bool "Enable ESP-IDF WiFi debug diagnostic output"
        default n
        depends on !WIFI_MODE_DISABLED
endmenu

menu "Fast Clock"
    config FASTCLOCK_DEFAULT
        bool "Enable FastClock"
        default n
        help
            Enabling this option will cause the ESP32 Command Station to
            advertise itself as an LCC Fast Clock.

    config FASTCLOCK_DEFAULT_ID
        hex "FastClock Clock ID"
        default 0x010100000100
        depends on FASTCLOCK_DEFAULT
        help
            This is the clock ID that will be created and advertised.
            The default Fast Clock uses ID 0x010100000100.

    config FASTCLOCK_RATE
        hex "FastClock rate quarters"
        default 4
        range -512 511
        depends on FASTCLOCK_DEFAULT
        help
            This is the clock ID that will be created and advertised.
            The default Fast Clock uses ID 0x010100000100.

    config FASTCLOCK_REALTIME
        bool "Enable real-time FastClock"
        default n
        depends on !WIFI_MODE_DISABLED
        select SNTP
        help
            Enabling this option will cause the ESP32 Command Station to
            advertise itself as an LCC real-time Fast Clock.

    config FASTCLOCK_REALTIME_ID
        hex "Real-time Clock ID"
        default 0x010100000101
        depends on FASTCLOCK_REALTIME
        help
            This is the clock ID that will be created and advertised.
            Real-Time clock defaults to 0x010100000101.
endmenu

menu "Thermal Monitor"
    config THERMALMONITOR
        bool "Enable thermal monitor"
        default n
        help
            Enables monitoring of an externally connected thermistor or similar
            IC such as MCP9701.

    choice THERMALMONITOR_TYPE
        bool "Thermistor/IC"
        depends on THERMALMONITOR
        config THERMALMONITOR_TYPE_MCP9700
            bool "MCP9700/MCP9700A"
        config THERMALMONITOR_TYPE_MCP9701
            bool "MCP9701/MCP9701A"
        config THERMALMONITOR_TYPE_CUSTOM
            bool "Custom"
    endchoice

    config THERMALMONITOR_ZERO_MV
        int "Millivolts at 0C"
        range 0 3300
        default 0
        default 500 if THERMALMONITOR_TYPE_MCP9700
        default 400 if THERMALMONITOR_TYPE_MCP9701
        depends on THERMALMONITOR
        help
            This value is used as a correction to the calculated millivolts
            reading of the ADC pin as a 0C starting point. For the MCP9700 it
            should be 500mV, MCP9701 should be 400mV.
    
    config THERMALMONITOR_MV_PER_C
        int "Millivolts per 1C"
        range 10 33000
        default 10
        default 100 if THERMALMONITOR_TYPE_MCP9700
        default 195 if THERMALMONITOR_TYPE_MCP9701
        depends on THERMALMONITOR
        help
            This value is used to convert the raw millivolts value into degrees.
            NOTE: This value needs to be multiplied by 10 to account for the
            fractions of a degree per millivolt.

    choice THERMALMONITOR_PIN
        bool "ADC pin"
        default THERMALMONITOR_ADC_CHANNEL_7
        depends on THERMALMONITOR
        help
            This pin must be connected to the thermistor/IC output pin.
        config THERMALMONITOR_ADC_CHANNEL_0
            bool "ADC1 Channel 0 (GPIO 36)"
        config THERMALMONITOR_ADC_CHANNEL_1
            bool "ADC1 Channel 1 (GPIO 37)"
            help
                Note this pin may not be exposed on all ESP32 modules
        config THERMALMONITOR_ADC_CHANNEL_2
            bool "ADC1 Channel 2 (GPIO 38)"
            help
                Note this pin may not be exposed on all ESP32 modules
        config THERMALMONITOR_ADC_CHANNEL_3
            bool "ADC1 Channel 3 (GPIO 39)"
        config THERMALMONITOR_ADC_CHANNEL_4
            bool "ADC1 Channel 4 (GPIO 32)"
        config THERMALMONITOR_ADC_CHANNEL_5
            bool "ADC1 Channel 5 (GPIO 33)"
        config THERMALMONITOR_ADC_CHANNEL_6
            bool "ADC1 Channel 6 (GPIO 34)"
        config THERMALMONITOR_ADC_CHANNEL_7
            bool "ADC1 Channel 7 (GPIO 35)"
    endchoice

    config THERMALMONITOR_ADC
        int
        default 0 if THERMALMONITOR_ADC_CHANNEL_0
        default 1 if THERMALMONITOR_ADC_CHANNEL_1
        default 2 if THERMALMONITOR_ADC_CHANNEL_2
        default 3 if THERMALMONITOR_ADC_CHANNEL_3
        default 4 if THERMALMONITOR_ADC_CHANNEL_4
        default 5 if THERMALMONITOR_ADC_CHANNEL_5
        default 6 if THERMALMONITOR_ADC_CHANNEL_6
        default 7 if THERMALMONITOR_ADC_CHANNEL_7
        depends on THERMALMONITOR
endmenu

menu "Advanced Configuration Settings"

    config ESP32CS_FORCE_FACTORY_RESET
        bool "Perform factory reset on startup"
        default n
        help
            Enabling this option will force clear all persistent configuration
            settings upon startup, including all LCC configuration data. This
            would not be recommended to be enabled for most use cases.

    config ESP32CS_FORCE_FACTORY_RESET_PIN
        int "Factory Reset pin"
        range -1 39
        default -1
        help
            When this pin is held LOW during startup all persistent
            configuration will be cleared and defaults will be restored. Note
            this will also clear the LCC configuration data.
endmenu
```
