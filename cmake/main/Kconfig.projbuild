## components/StatusDisplay/Kconfig.projbuild
```kconfig
menu "Status Display"
    choice DISPLAY_TYPE
        bool "Type of display"
        default DISPLAY_TYPE_NONE
        config DISPLAY_TYPE_NONE
            bool "None"
        config DISPLAY_TYPE_OLED
            bool "OLED"
        config DISPLAY_TYPE_LCD
            bool "LCD"
    endchoice

    config DISPLAY_SCL
        int "I2C SCL pin"
        default 22
        range 0 32
        depends on DISPLAY_TYPE_OLED || DISPLAY_TYPE_LCD

    config DISPLAY_SDA
        int "I2C SDA pin"
        default 21
        range 0 32
        depends on DISPLAY_TYPE_OLED || DISPLAY_TYPE_LCD

    choice DISPLAY_LCD_TYPE
        bool "Type of LCD display"
        default DISPLAY_LCD_20x4
        depends on DISPLAY_TYPE_LCD
        config DISPLAY_LCD_20x4
            bool "20 columns, 4 lines"
        config DISPLAY_LCD_16x4
            bool "16 columns, 4 lines"
        config DISPLAY_LCD_20x2
            bool "20 columns, 2 lines"
        config DISPLAY_LCD_16x2
            bool "16 columns, 2 lines"
    endchoice

    config DISPLAY_LCD_BACKLIGHT
        bool "Enable LCD Backlight"
        help
            Enabling this option will set the backlight bitmask to ON. Some
            LCD displays require this to be LOW.
        default y
        depends on DISPLAY_TYPE_LCD

    config DISPLAY_LCD_ENABLE_BITMASK
        hex "LCD Enable bitmask"
        help
            Bit to set for the Enable pin
        default 0x04
        depends on DISPLAY_TYPE_LCD

    config DISPLAY_LCD_REGISTER_SELECT_BITMASK
        hex "LCD Register Select bitmask"
        help
            Bit to set for the Register Select pin
        default 0x01
        depends on DISPLAY_TYPE_LCD

    config DISPLAY_LCD_BACKLIGHT_BITMASK
        hex "LCD Backlight Enable bitmask"
        help
            Bit to set for the Backlight pin
        default 0x08 if DISPLAY_LCD_BACKLIGHT
        default 0x00 if !DISPLAY_LCD_BACKLIGHT
        depends on DISPLAY_TYPE_LCD

    config DISPLAY_OLED_RESET_PIN
        int "OLED Reset pin"
        default -1
        help
            This optional pin can be used if the OLED display uses a
            dedicated pin for reset.
        depends on DISPLAY_TYPE_OLED

    config DISPLAY_OLED_VFLIP
        bool "Vertically flip"
        default n
        depends on DISPLAY_TYPE_OLED

    choice DISPLAY_OLED_TYPE
        bool "Size of OLED display"
        default DISPLAY_OLED_128x64
        depends on DISPLAY_TYPE_OLED
        config DISPLAY_OLED_128x64
            bool "128x64"
        config DISPLAY_OLED_128x32
            bool "128x32"
        config DISPLAY_OLED_96x16
            bool "96x16"
    endchoice

    config DISPLAY_OLED_CONTRAST
        int "Contrast ratio"
        help
            This controls how bright the OLED screen appears, default ratio
            is 128 (out of 255).
        depends on DISPLAY_TYPE_OLED
        default 128
        range 0 255

    choice DISPLAY_OLED_FONT
        bool "OLED Font"
        depends on DISPLAY_TYPE_OLED
        default DISPLAY_OLED_FONT_BOLD
        config DISPLAY_OLED_FONT_THIN
            bool "Thin"
        config DISPLAY_OLED_FONT_BOLD
            bool "Bold"
    endchoice

    choice DISPLAY_LCC_LOGGING
        bool "LCC Stat Logging"
        default DISPLAY_LCC_LOGGING_NONE
        config DISPLAY_LCC_LOGGING_VERBOSE
            bool "Verbose"
        config DISPLAY_LCC_LOGGING_NONE
            bool "None"
    endchoice

    config DISPLAY_LINE_COUNT
        int
        default 8 if DISPLAY_OLED_128x64
        default 4 if DISPLAY_OLED_128x32 || DISPLAY_LCD_20x4 || DISPLAY_LCD_16x4
        default 2 if DISPLAY_OLED_96x16 || DISPLAY_LCD_20x2 || DISPLAY_LCD_16x2
        default 1

    config DISPLAY_COLUMN_COUNT
        int
        default 20 if DISPLAY_LCD_20x4 || DISPLAY_LCD_16x4
        default 16 if DISPLAY_OLED_128x64 || DISPLAY_OLED_128x32 || DISPLAY_LCD_16x4 || DISPLAY_LCD_16x2
        default 12 if DISPLAY_OLED_96x16
        default 1

    config DISPLAY_OLED_WIDTH
        int
        default 96 if DISPLAY_OLED_96x16
        default 128 if DISPLAY_OLED_128x64 || DISPLAY_OLED_128x32
        depends on DISPLAY_TYPE_OLED

    config DISPLAY_OLED_HEIGHT
        int
        default 64 if DISPLAY_OLED_128x64
        default 32 if DISPLAY_OLED_128x32
        default 16 if DISPLAY_OLED_96x16
        depends on DISPLAY_TYPE_OLED

    config DISPLAY_I2C_TIMEOUT_MSEC
        int
        default 10

    config DISPLAY_I2C_BUS_SPEED
        int
        default 700000 if DISPLAY_TYPE_OLED
        default 100000 if DISPLAY_TYPE_LCD
endmenu
```

## components/StatusLED/Kconfig.projbuild
```kconfig
config STATUS_LED
    bool "Enable Status LED"
    default n

menu "Status LED"
    depends on STATUS_LED
    
    config STATUS_LED_DATA_PIN
        int "LED data pin"
        range 0 32
        default 22

    config STATUS_LED_BRIGHTNESS
        int "LED brightness"
        range 8 255
        default 128
        help
            Controls how bright the LEDs will appear. The lower the value the darker the LED will appear.
            Recommended value is 128.

    choice STATUS_LED_TYPE
        bool "LED type"
        default STATUS_LED_TYPE_WS281X
        help
            This defines the type of LED, the following types are supported:
            STATUS_LED_TYPE  RESET PULSE  LED TYPES
            WS2811           300 uS       WS2811
            WS281X           300 uS       NeoPixel, WS2812, WS2813
            WS281X_800K      50 uS        NeoPixel, WS2812, WS2813
            WS281X_400K      50 uS        NeoPixel, WS2812, WS2813
            SK6812           80 uS        SK6812
            LC6812           80 uS        LC6812
            APA106           50 uS        APA106
            Note: APA106 is the type used for testing.
        config STATUS_LED_TYPE_WS281X
            bool "WS281X"
        config STATUS_LED_TYPE_WS281X_800K
            bool "WS281X (800k)"
        config STATUS_LED_TYPE_WS281X_400K
            bool "WS281X (400k)"
        config STATUS_LED_TYPE_WS2811
            bool "WS2811"
        config STATUS_LED_TYPE_SK6812
            bool "SK6812"
        config STATUS_LED_TYPE_LC6812
            bool "LC6812"
        config STATUS_LED_TYPE_APA106
            bool "APA106"
    endchoice

    choice STATUS_LED_COLOR
        bool "LED color order"
        default STATUS_LED_COLOR_RGB
        config STATUS_LED_COLOR_RGB
            bool "Red, Green, Blue"
        config STATUS_LED_COLOR_BRG
            bool "Blue, Red, Green"
        config STATUS_LED_COLOR_RBG
            bool "Red, Blue, Green"
        config STATUS_LED_COLOR_RGBW
            bool "Red, Green, Blue, White"
        config STATUS_LED_COLOR_GRBW
            bool "Green, Red, Blue, White"
    endchoice

    config STATUS_LED_UPDATE_INTERVAL_MSEC
        int "LED update frequency (milliseconds)"
        default 450
endmenu
```

## components/TaskMonitor/Kconfig.projbuild
```kconfig
menu "Task Monitor"

    config TASK_MONITOR_INTERVAL_SEC
        int "Seconds between task monitoring printing"
        default 45

    config TASK_LIST_REPORT
        bool "Print FreeRTOS task list periodically"
        default n
        select FREERTOS_VTASKLIST_INCLUDE_COREID
        select FREERTOS_USE_TRACE_FACILITY
        select FREERTOS_GENERATE_RUN_TIME_STATS

    config TASK_LIST_INTERVAL_SEC
        int "Seconds between FreeRTOS task list printing"
        default 300
        depends on TASK_LIST_REPORT

endmenu
```

## components/TrainDatabase/Kconfig.projbuild
```kconfig
menu "Locomotive Roster"

    config ROSTER_AUTO_IDLE_NEW_LOCOS
        bool "Automatically Idle newly created locomotives"
        default n
        help
            By enabling this option, when any train is newly added to the
            roster it will default to automatic idle.

    config ROSTER_AUTO_CREATE_ENTRIES
        bool "Create a roster entry for new trains on first use"
        default y
        help
            By enabling this option, any train that is requested that does not
            already exist in the locomotive roster will be automatically added
            to the roster using DCC 128 speed step mode.

    config ROSTER_PERSISTENCE_INTERVAL_SEC
        int "Locomotive roster persistence interval (seconds)"
        default 30
        help
            Any changes to locomotives in the roster will be persisted after
            this many seconds to persistant storage (SPIFFS or SD). This is
            done to minimize the number of write operations when roster entries
            are modified.

endmenu
```
